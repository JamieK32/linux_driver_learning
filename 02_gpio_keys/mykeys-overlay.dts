/dts-v1/;
/plugin/;


/ {
    compatible = "brcm,bcm2711";

    fragment@0 {
        target-path = "/";
        __overlay__ {
            mykeys {
                compatible = "mycompany,mykeys";
                key-gpios = <&gpio 26 1>;
            };
        };
    };
};

